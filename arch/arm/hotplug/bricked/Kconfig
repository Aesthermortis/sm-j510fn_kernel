## arch/arm/hotplug/bricked/Kconfig
```kconfig
config BRICKED_HOTPLUG
	bool "Enable kernel based mpdecision"
	depends on MSM_RUN_QUEUE_STATS
	default y
	help
	 This enables kernel based multi core control.
	 (up/down hotplug based on load)
```
